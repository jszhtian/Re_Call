// dllmain.cpp : 定义 DLL 应用程序的入口点。
#include "framework.h"
PVOID g_pOldCreateFontIndirectA = CreateFontIndirectA;
typedef HFONT(WINAPI* PfuncCreateFontIndirectA)(LOGFONTA* lplf);
HFONT WINAPI HookCreateFontIndirectA(LOGFONTA* lplf)
{
    lplf->lfCharSet = GB2312_CHARSET;
    lstrcpyA(lplf->lfFaceName, "SimHei");
    return ((PfuncCreateFontIndirectA)g_pOldCreateFontIndirectA)(lplf);
}

PVOID g_pOldCreateFontA = CreateFontA;
typedef int (WINAPI* PfuncCreateFontA)(int nHeight,
	int nWidth,
	int nEscapement,
	int nOrientation,
	int fnWeight,
	DWORD fdwltalic,
	DWORD fdwUnderline,
	DWORD fdwStrikeOut,
	DWORD fdwCharSet,
	DWORD fdwOutputPrecision,
	DWORD fdwClipPrecision,
	DWORD fdwQuality,
	DWORD fdwPitchAndFamily,
	LPCTSTR lpszFace);
int WINAPI HookCreateFontA(int nHeight,
	int nWidth,
	int nEscapement,
	int nOrientation,
	int fnWeight,
	DWORD fdwltalic,
	DWORD fdwUnderline,
	DWORD fdwStrikeOut,
	DWORD fdwCharSet,
	DWORD fdwOutputPrecision,
	DWORD fdwClipPrecision,
	DWORD fdwQuality,
	DWORD fdwPitchAndFamily,
	LPCTSTR lpszFace)
{
	lstrcpyA((char*)lpszFace, "SimHei");
	return ((PfuncCreateFontA)g_pOldCreateFontA)(nHeight,
		nWidth,
		nEscapement,
		nOrientation,
		fnWeight,
		fdwltalic,
		fdwUnderline,
		fdwStrikeOut,
		GB2312_CHARSET,
		fdwOutputPrecision,
		fdwClipPrecision,
		fdwQuality,
		fdwPitchAndFamily,
		lpszFace);
}

void WINAPI APIHook()
{
	DetourTransactionBegin();
	DetourAttach(&g_pOldCreateFontIndirectA, HookCreateFontIndirectA);
	if (DetourTransactionCommit() != NOERROR)
	{
		MessageBox(NULL, L"Hook CreateFontIndirectA Error", L"APIHook", MB_OK | MB_ICONERROR);
		ExitProcess(-1);
	}

	DetourTransactionBegin();
	DetourAttach(&g_pOldCreateFontA, HookCreateFontA);
	if (DetourTransactionCommit() != NOERROR)
	{
		MessageBox(NULL, L"Hook CreateFontA Error", L"APIHook", MB_OK | MB_ICONERROR);
		ExitProcess(-1);
	}

}


char* TitleName = nullptr;

void GetSelTitle()
{
	//char** Start = (char**)(BaseAddr + 0x98878);
	char** Start = (char**)(BaseAddr + 0x96878);
	for (int i = 0; i < 0x8c0; i++)
	{
		//cout << hex << *(char**)(Start + i) << "|" << *(char**)(Start + i + 1) << endl;
		cout << "\t{ \"" << *(char**)(Start + i) << "\", \"" << *(char**)(Start + i + 1) << "\" }," << endl;
		i++;

		//cout << hex << *(char**)(Start + i) << endl;
	}
}

///*
const char* SaveTitleEng[][2] =
{
        { "ds_1129b_cm", "Welcome to Paradise" },
        { "ds_1129c_cm", "Welcome to Paradise" },
        { "ds_1130a_cm", "Awakening in Paradise" },
        { "ds_1130b_cm", "Some Odd Classmates" },
        { "ds_1130b2_cm", "Invitation to the Student Council Room" },
        { "ds_1130c_cm", "A Strange Being" },
        { "ds_1130d_cm", "The Night Visitor" },
        { "ds_1201a_cm", "A Taste of What's to Come" },
        { "ds_1201c_cm", "The Lighthouse, and the Girl with the Hat" },
        { "ds_1202b_cm", "The Barrier Sits on the Roof" },
        { "ds_1203c_cm", "Her Friend is a Hat?" },
        { "ds_1204b_cm", "The President is Popular?" },
        { "ds_1205a_cm", "Weekend Chaos" },
        { "ds_1205b_cm", "Spirited Noeri" },
        { "ds_1206a_cm", "The Morning Screenplay" },
        { "ds_1206b_cm", "A Lively Welcome" },
        { "ds_1206d_cm", "Ame's Heart" },
        { "ds_1207b_cm", "Looking Forward to X-Mas?" },
        { "ds_1208a_cm", "A New Feeling" },
        { "ds_1208b_cm", "Rooftop Ritual" },
        { "ds_1208c_cm", "Blessings from the Sky" },
        { "ds_1209a_cm", "The Usual Noeri" },
        { "ds_1209b_cm", "How Hazuki Works" },
        { "ds_1209d_cm", "Noeri is On My Side" },
        { "ds_1210a_cm", "A Normal Morning at Last" },
        { "ds_1210c1_cm", "A Girl Like Ame" },
        { "ds_1210c2_cm", "A Girl That I Like" },
        { "ds_1210c_cm", "Pageant Burnout" },
        { "ds_1211b1_cm", "Hazuki's Routine" },
        { "ds_1211b2_cm", "Lunch with the Daughter of Darkness" },
        { "ds_1211b_cm", "Where to Have Lunch" },
        { "ds_1211c1_cm", "What Himari Sees" },
        { "ds_1211c2_cm", "I'll Be in the Pageant" },
        { "ds_1211c_cm", "The Weekend..." },
        { "ds_1212a_cm", "A Productive Day Off?" },
        { "ds_1212b_cm", "Communion with the Daughter of Darkness" },
        { "ds_1213a_cm", "A Wacky Sunday" },
        { "ds_1213b_cm", "Who's Fooling Who?" },
        { "ds_1214a_cm", "A Send-Off from Himari" },
        { "ds_1214b1_cm", "That Was Fun" },
        { "ds_1214b2_cm", "Not During Lunch" },
        { "ds_1214b_cm", "The Empty Banana" },
        { "ds_1214c_cm", "What Hazuki Likes" },
        { "ds_1215a_cm", "I'm Awake Today" },
        { "ds_1215c_cm", "A Place to Forget About Time" },
        { "ds_1216a_cm", "Did it Have a Fish?" },
        { "ds_1216c_cm", "Next Shot will Hit the Mark" },
        { "ds_1217b1_cm", "I'll See You in the Council Room" },
        { "ds_1217b2_cm", "The Peerless Alchemist" },
        { "ds_1217b_cm", "The Lost Lunch" },
        { "ds_1217c1_cm", "A Hidden Talent?" },
        { "ds_1217c2_cm", "Everyone Loves the Sister Character!" },
        { "ds_1217c_cm", "Encroaching on the Demon" },
        { "ds_1217d1_cm", "When the Day Comes" },
        { "ds_1217d2_cm", "When the Day Comes" },
        { "ds_1217d3_cm", "When the Day Comes" },
        { "ds_1217d4_cm", "When the Day Comes" },
        { "ds_1217d5_cm", "When the Day Comes" },
        { "ds_1217d6_cm", "When the Day Comes" },
        { "ds_1217d_cm", "When the Day Comes" },
        { "ds_1225b_me", "These Kinds of Endings Exist, too" },
        { "ds_1218c_hm", "A Candidate Appears" },
        { "ds_1219b_hm", "At the Starting Line" },
        { "ds_1219d_hm", "A Garbled Text" },
        { "ds_1220b_hm", "Shopping Can Be Awkward" },
        { "ds_1221a_hm", "A New Week's Morning" },
        { "ds_1221c_hm", "An Ace up Her Sleeve" },
        { "ds_1222d_hm", "Just Another Day" },
        { "ds_1223d_hm", "Coming Along" },
        { "ds_1224c_hm", "Almost There" },
        { "ds_1225a_hm", "The Usual Himari" },
        { "ds_1225b_hm", "The Satin Angel" },
        { "ds_1226a_hm", "To Where the Flower Blooms" },
        { "ds_1226c_hm", "The Trouble with Me and Himari" },
        { "ds_1227b_hm", "Himari's SOS" },
        { "ds_1228b_hm", "Even Though the Sky's So Blue" },
        { "ds_1230b_hm", "A Little Horseplay" },
        { "ds_1230d_hm", "A Thought Under the Stars" },
        { "ds_1231b_hm", "To Himari" },
        { "ds_1301a_hm", "A Beginning, and a Beginning" },
        { "ds_1302b_hm", "Just Starting Out" },
        { "ds_1302c_hm", "From Sleeves to Swimsuits" },
        { "ds_1303b_hm", "Totally Exposed" },
        { "ds_1305c_hm", "Gone with the Wind" },
        { "ds_1307b_hm", "Translucent Satin" },
        { "ds_1307d_hm", "Mutual Desire" },
        { "ds_1308a_hm", "A New Morning" },
        { "ds_1309d_hm", "We're the Same" },
        { "ds_1309e_hm", "With Himari" },
        { "ds_1310b_hm", "Waking up, Feeling Invigorated" },
        { "ds_1311a_hm", "The Refreshing Walk to School" },
        { "ds_1311c_hm", "An Odd Mood" },
        { "ds_1312a_hm", "A Morning Goodbye" },
        { "ds_1312b_hm", "A Rare Menu Item" },
        { "ds_1312c_hm", "A Lonely Sunset" },
        { "ds_1313a_hm", "Accumulation of Worries" },
        { "ds_1313c_hm", "A Random Present" },
        { "ds_1313d_hm", "To See Your Joyful Face" },
        { "ds_1316b_hm", "First Date in Forever" },
        { "ds_1317b_hm", "Sudden Insecurity" },
        { "ds_1317d_hm", "How the Flow of Time Continues" },
        { "ds_1318a_hm", "Sunny Skies, Cloudy Heart" },
        { "ds_1318c_hm", "A Fight" },
        { "ds_1322d_hm", "Back to Normal" },
        { "ds_1323c_hm", "A Turned Face" },
        { "ds_1323e_hm", "Impotence" },
        { "ds_1324b_hm", "A Lost Heart" },
        { "ds_1325a_hm", "What Must be Done" },
        { "ds_1326c_hm", "Coming to This Island" },
        { "ds_1327b_hm", "What it Means to be a Friend" },
        { "ds_1327c_hm", "Himari" },
        { "ds_1328a_hm", "Just Give Me a Sign" },
        { "ds_1328b_hm", "A Thread to Pull" },
        { "ds_1330b_hm", "A Thought to Carry" },
        { "ds_1331d_hm", "Let's Start Here" },
        { "ds_1411d_hm", "The Second Hologram" },
        { "ds_1412c_hm", "If You Think About It" },
        { "ds_1218c_ne", "What I Can Do for You" },
        { "ds_1219b_ne", "The Character for the Pageant" },
        { "ds_1220b_ne", "A Curry For the Ages" },
        { "ds_1221c_ne", "It's Showtime!" },
        { "ds_1222c_ne", "A Call from My Sister" },
        { "ds_1223c_ne", "Tendency and Strategy" },
        { "ds_1224d_ne", "Tomorrow's the Big Day" },
        { "ds_1225b_ne", "A Confession" },
        { "ds_1226b_ne", "Our First Date" },
        { "ds_1226d_ne", "Do Things Right" },
        { "ds_1227c_ne", "Actual(?) First Date" },
        { "ds_1228a_ne", "We're Maturing" },
        { "ds_1228c_ne", "Our Feelings Connect" },
        { "ds_1229c_ne", "How's the Food We Make Together?" },
        { "ds_1229d_ne", "A Heartfelt Union" },
        { "ds_1230a_ne", "Our First True Morning Together" },
        { "ds_1230b_ne", "A Blast at the Beach" },
        { "ds_1231d_ne", "Are We Family?" },
        { "ds_1301a_ne", "A Small Misunderstanding" },
        { "ds_1302b_ne", "A Distant Yet Familiar Memory" },
        { "ds_1303c_ne", "Noeri's Gentle Concern" },
        { "ds_1304c_ne", "The Line in the Sand" },
        { "ds_1304d_ne", "Hush Hush in the Bathroom" },
        { "ds_1306b_ne", "It Couldn't be Asked" },
        { "ds_1307c_ne", "The Changes Begin" },
        { "ds_1308a_ne", "The Talk of the School" },
        { "ds_1308c_ne", "She's Just Shy" },
        { "ds_1311a_ne", "Don't Treat Me Like a Kid" },
        { "ds_1311b_ne", "Nightmare" },
        { "ds_1312a_ne", "Happiness, or...?" },
        { "ds_1313a_ne", "Happy, Right?" },
        { "ds_1314a_ne", "A Confused Caretaker" },
        { "ds_1316a_ne", "True Happiness" },
        { "ds_1317d_ne", "Shards of Happiness in Flux" },
        { "ds_1318b_ne", "Cold is Pain" },
        { "ds_1319b_ne", "An Unbearable Three Minutes" },
        { "ds_1320b_ne", "The Truth Coming to Light" },
        { "ds_1320c_ne", "A Genuine Family" },
        { "ds_1414b_ne", "A Step Toward True Happiness" },
        { "ds_1218c_hd", "Your Request is Obvious" },
        { "ds_1219b_hd", "A Mail from Yamato" },
        { "ds_1220b_hd", "Her Chosen Attire" },
        { "ds_1221a_hd", "Thanks, Yamato" },
        { "ds_1221c_hd", "A Nap Never Hurt" },
        { "ds_1222b_hd", "Lunch in Return" },
        { "ds_1223c_hd", "Last Year in Review" },
        { "ds_1224c_hd", "A Trial" },
        { "ds_1225a_hd", "Christmas Morning" },
        { "ds_1225b_hd", "A Pageant on Christmas" },
        { "ds_1226a_hd", "Apologies For Last Night" },
        { "ds_1227a_hd", "Busy Again Today" },
        { "ds_1228a_hd", "I'm Heading to the Mainland" },
        { "ds_1228b_hd", "The Girl in the Car" },
        { "ds_1228d_hd", "A Sudden Date at Night" },
        { "ds_1229a_hd", "A Message from the Mainland" },
        { "ds_1304d_hd", "Photo Op" },
        { "ds_1305d_hd", "Karaoke Date" },
        { "ds_1306d_hd", "A Night Kiss by the Sea" },
        { "ds_1307d_hd", "Skinship" },
        { "ds_1308a_hd", "The Morning Back" },
        { "ds_1308b_hd", "It was a dream. Or was it?" },
        { "ds_1308d_hd", "An Illusory Date" },
        { "ds_1309b_hd", "The Student President" },
        { "ds_1309d_hd", "Which One Was It?" },
        { "ds_1310a_hd", "That Name is..." },
        { "ds_1311b_hd", "Research It Yourself" },
        { "ds_1311c_hd", "Information on Haruhi" },
        { "ds_1312c_hd", "Do not Meet with Haruhi..." },
        { "ds_1313c_hd", "Always Pushing Herself" },
        { "ds_1314b_hd", "Curry Battle" },
        { "ds_1315c_hd", "Just Let Me See You Home" },
        { "ds_1317d_hd", "I Cannot Do That" },
        { "ds_1318b_hd", "The President's Lunch" },
        { "ds_1319b_hd", "Hazuki Murasaki, as Told by Yamato" },
        { "ds_1322b_hd", "The Impending Collapse" },
        { "ds_1322c_hd", "From the Infirmary Home" },
        { "ds_1323d_hd", "Save Her" },
        { "ds_1324a_hd", "The Fated Morning" },
        { "ds_1324b_hd", "A Father's Thoughts" },
        { "ds_1324c1_hd", "A Decade's Hidden Truth" },
        { "ds_1324c2_hd", "Reunited" },
        { "ds_1324c3_hd", "The Trial is Over" },
        { "ds_1324d_hd", "Joined in Body and Soul" },
        { "ds_1412c_hd", "A Message from the President" },
        { "ds_1218c_io", "Rise, Daughter of Darkness" },
        { "ds_1219b_io", "Pageant Strategy" },
        { "ds_1219c_io", "Insufficient War Funds?" },
        { "ds_1220b_io", "Io's Workshop" },
        { "ds_1221b_io", "A Supreme Alliance" },
        { "ds_1222b_io", "What it Means to Dream" },
        { "ds_1223c_io", "When the Wings of Darkness Spread" },
        { "ds_1224c_io", "A Truce" },
        { "ds_1225a_io", "The Morning of Battle" },
        { "ds_1225b_io", "Kneel Before Her" },
        { "ds_1226b_io", "Rescue the Familiar" },
        { "ds_1227b_io", "Offer Thy Hand" },
        { "ds_1228a_io", "Io's Panties Are Also Dark" },
        { "ds_1228b_io", "The Witch Lady" },
        { "ds_1229d_io", "Well, It's the Wrong Order" },
        { "ds_1230a_io", "What You Have Shown Me" },
        { "ds_1231d_io", "A Comfortable End to the Year" },
        { "ds_1301b_io", "The Long Road to Prayer" },
        { "ds_1302b_io", "An Unfitting Voice" },
        { "ds_1304b_io", "What an Acolyte Can Do" },
        { "ds_1305b_io", "At the Beach, but..." },
        { "ds_1306b_io", "How Io Ought to be" },
        { "ds_1307b_io", "Hidden in Plain Sight" },
        { "ds_1308a_io", "A New Semester" },
        { "ds_1308c_io", "Consulting with a Friend" },
        { "ds_1309d_io", "Comrades" },
        { "ds_1310a_io", "Himari's Gut Feeling" },
        { "ds_1310b_io", "What We Feared the Most" },
        { "ds_1310c_io", "Sealed Consciousness" },
        { "ds_1311c_io", "A Call to the Dream World" },
        { "ds_1312c_io", "Some Gifts You Might Like" },
        { "ds_1313c_io", "Support" },
        { "ds_1314d_io", "Clashing Gears" },
        { "ds_1315a_io", "Just Your Heart" },
        { "ds_1315c_io", "A Silent Room" },
        { "ds_1316c2_io", "Conviction" },
        { "ds_1316c_io", "To Be Happy" },
        { "ds_1316d_io", "To the Underworld, Hero" },
        { "ds_1317c2_io", "Your Hand in Mine" },
        { "ds_1317c_io", "The True Io" },
        { "ds_1317d_io", "A Contract Renewed" },
        { "ds_1318c_io", "Undoubtedly, the Daughter of Darkness" },
        { "ds_1318d_io", "A Glimmer of Happiness" },
        { "ds_2014a_io", "Together, Till Death Do Us Part" },
        { "ds_1218c_am", "My First Forehead Flick!" },
        { "ds_1221c_am", "You're Gonna Enter!" },
        { "ds_1222c_am", "A Perfect Transformation!" },
        { "ds_1224c_am", "Question Practice, Go!" },
        { "ds_1225a_am", "Christmas Morning!" },
        { "ds_1225b_am", "The Pageant!" },
        { "ds_1226b_am", "Happiness is Hard!" },
        { "ds_1227c_am", "You There, Help me Think!" },
        { "ds_1228a_am", "Duh, Happiness is Love!" },
        { "ds_1228b_am", "I Saw it Coming!" },
        { "ds_1229b_am", "Was it a Date?!" },
        { "ds_1230b_am", "Reverse Girl Hunting?!" },
        { "ds_1231d_am", "New Year's Greeting!" },
        { "ds_1301b_am", "Bow Twice, Clap Twice, Pray!" },
        { "ds_1303c_am", "The Mountains are Nice, Too!" },
        { "ds_1307d_am", "The Stars are so Beautiful" },
        { "ds_1308b_am", "Get Enough of the Student Life?!" },
        { "ds_1310b_am", "Hey, Where'd You Go?" },
        { "ds_1313c_am", "Chocolate Banana!" },
        { "ds_1315a_am", "The Local News, huh..." },
        { "ds_1316a_am", "I'm Worried..." },
        { "ds_1316d_am", "Her Emotional Range..." },
        { "ds_1317b_am", "My Own Feelings..." },
        { "ds_1318c_am", "Just Say It" },
        { "ds_1319c_am", "Enjoying A Chocolate Banana, Together!" },
        { "ds_1320a_am", "Good Morning!" },
        { "ds_1321d_am", "How We Touch One Another" },
        { "ds_1322c_am", "Where the Heck are we Go#b?!" },
        { "ds_1322d_am", "Together at Last" },
        { "ds_1323b_am", "The Sea is Beautiful, Too!" },
        { "ds_1323d_am", "For You, I'd..." },
        { "ds_1325a_am", "Next to Me in Class" },
        { "ds_1325c_am", "Your Heart's Desire!" },
        { "ds_1325d_am", "I Couldn't Hold Back My Tears..." },
        { "ds_1607b_am", "Ame is All Around Us" }
};

const char* SaveTitleJpn[][2]=
{
        { "ds_1129b_cm", "欢迎进入乐园aaaaaaaaaaaaaaaaaaa" },
        { "ds_1129c_cm", "欢迎来到乐园" },
        { "ds_1130a_cm", "在乐园中醒来" },
        { "ds_1130b_cm", "个性鲜明的同学" },
        { "ds_1130b2_cm", "学生会室里的招待" },
        { "ds_1130c_cm", "充满违和感的本体" },
        { "ds_1130d_cm", "深夜来访者" },
        { "ds_1201a_cm", "从此开始无穷的喧闹" },
        { "ds_1201c_cm", "灯塔与戴帽子的少女" },
        { "ds_1202b_cm", "屋顶上竟是结界" },
        { "ds_1203c_cm", "奇异的帽子友人" },
        { "ds_1204b_cm", "会长人气超高？" },
        { "ds_1205a_cm", "吵闹的周末" },
        { "ds_1205b_cm", "甜言蜜语乃绘里" },
        { "ds_1206a_cm", "达成约定的早晨" },
        { "ds_1206b_cm", "热闹的欢迎会" },
        { "ds_1206d_cm", "在天心中" },
        { "ds_1207b_cm", "期待着圣诞派对？" },
        { "ds_1208a_cm", "应是一种新的感觉" },
        { "ds_1208b_cm", "屋顶上的神秘仪式" },
        { "ds_1208c_cm", "天空给予我们的东西" },
        { "ds_1209a_cm", "与往常一样的乃绘里" },
        { "ds_1209b_cm", "会长的工作情况" },
        { "ds_1209d_cm", "乃绘里是友军" },
        { "ds_1210a_cm", "又一个普通的早晨" },
        { "ds_1210c_cm", "难觅候选人" },
        { "ds_1210c1_cm", "天那样的人" },
        { "ds_1210c2_cm", "所喜欢的人" },
        { "ds_1211b_cm", "何处享用午餐" },
        { "ds_1211b1_cm", "会长的日常" },
        { "ds_1211b2_cm", "与魔王之女的午餐" },
        { "ds_1211c_cm", "周末果然……" },
        { "ds_1211c1_cm", "阳茉莉之瞳所映为" },
        { "ds_1211c2_cm", "选美比赛与我" },
        { "ds_1212a_cm", "有效利用周末？" },
        { "ds_1212b_cm", "有魔王之女的风景" },
        { "ds_1213a_cm", "周日的忙忙碌碌" },
        { "ds_1213b_cm", "小鸟依人揭开面纱变脱缰野马" },
        { "ds_1214a_cm", "阳茉莉的目送" },
        { "ds_1214b_cm", "香蕉让人急不可耐" },
        { "ds_1214b1_cm", "感觉很开心哦" },
        { "ds_1214b2_cm", "回避吃饭时间" },
        { "ds_1214c_cm", "遥月喜欢的东西" },
        { "ds_1215a_cm", "清醒之日" },
        { "ds_1215c_cm", "忘时之日" },
        { "ds_1216a_cm", "并没有叼着鱼" },
        { "ds_1216c_cm", "下一枪能中吗" },
        { "ds_1217b_cm", "彷徨的便当盒" },
        { "ds_1217b1_cm", "学生会室的会面" },
        { "ds_1217b2_cm", "绝世炼金术师" },
        { "ds_1217c_cm", "魔族的侵蚀" },
        { "ds_1217c1_cm", "被隐藏的才能？" },
        { "ds_1217c2_cm", "妹系角色很棒哦！" },
        { "ds_1217d_cm", "太阳升起时" },
        { "ds_1217d1_cm", "太阳升起时" },
        { "ds_1217d2_cm", "太阳升起时" },
        { "ds_1217d3_cm", "太阳升起时" },
        { "ds_1217d4_cm", "太阳升起时" },
        { "ds_1217d5_cm", "太阳升起时" },
        { "ds_1217d6_cm", "太阳升起时" },
        { "ds_1225b_me", "未曾设想的结局" },
        { "ds_1218c_hm", "突然而至的候选者" },
        { "ds_1219b_hm", "起跑线上" },
        { "ds_1219d_hm", "邮件恐慌" },
        { "ds_1220b_hm", "困难的选服" },
        { "ds_1221a_hm", "周一的清晨" },
        { "ds_1221c_hm", "选美比赛的秘诀" },
        { "ds_1222d_hm", "平凡的一天" },
        { "ds_1223d_hm", "准备进展顺利" },
        { "ds_1224c_hm", "准备万全" },
        { "ds_1225a_hm", "一如既往的阳茉莉" },
        { "ds_1225b_hm", "漂泊的天使" },
        { "ds_1226a_hm", "高岭之花盛开的地方" },
        { "ds_1226c_hm", "我与阳茉莉的困惑" },
        { "ds_1227b_hm", "阳茉莉ＳＯＳ" },
        { "ds_1228b_hm", "天空是如此湛蓝" },
        { "ds_1230b_hm", "略显活跃" },
        { "ds_1230d_hm", "星空的思念" },
        { "ds_1231b_hm", "对阳茉莉而言" },
        { "ds_1301a_hm", "开始与开端" },
        { "ds_1302b_hm", "纯真无邪的二人" },
        { "ds_1302c_hm", "从长袖到泳装" },
        { "ds_1303b_hm", "毫无防备的姿态" },
        { "ds_1305c_hm", "风的恶作剧" },
        { "ds_1307b_hm", "纯洁的浪花" },
        { "ds_1307d_hm", "互相寻求的心" },
        { "ds_1308a_hm", "崭新的早晨" },
        { "ds_1309d_hm", "志同道合的伙伴" },
        { "ds_1309e_hm", "与阳茉莉的结合" },
        { "ds_1310b_hm", "非常温柔的唤醒" },
        { "ds_1311a_hm", "清爽的上学路" },
        { "ds_1311c_hm", "奇怪的举止" },
        { "ds_1312a_hm", "早上的送行" },
        { "ds_1312b_hm", "稀有菜单" },
        { "ds_1312c_hm", "寂寞的黄昏" },
        { "ds_1313a_hm", "越来越担心" },
        { "ds_1313c_hm", "意外的礼物" },
        { "ds_1313d_hm", "所见为幸福的脸庞" },
        { "ds_1316b_hm", "久违的约会" },
        { "ds_1317b_hm", "突然的不安" },
        { "ds_1317d_hm", "时间流逝的方式" },
        { "ds_1318a_hm", "外晴心阴" },
        { "ds_1318c_hm", "气势汹汹" },
        { "ds_1322d_hm", "许久不见的风格" },
        { "ds_1323c_hm", "侧脸" },
        { "ds_1323e_hm", "什么也做不到" },
        { "ds_1324b_hm", "无处寄托的心" },
        { "ds_1325a_hm", "应该做的事" },
        { "ds_1326c_hm", "来到此岛" },
        { "ds_1327b_hm", "所谓至交" },
        { "ds_1327c_hm", "阳茉莉" },
        { "ds_1328a_hm", "寻找线索" },
        { "ds_1328b_hm", "抓住的线索" },
        { "ds_1330b_hm", "寄托的思念" },
        { "ds_1331d_hm", "从现在起步" },
        { "ds_1411d_hm", "二见全息投影" },
        { "ds_1412c_hm", "仔细考量" },
        { "ds_1218c_hd", "被看穿的愿望" },
        { "ds_1219b_hd", "大和发来的邮件" },
        { "ds_1220b_hd", "她所选的服装" },
        { "ds_1221a_hd", "Thank youー大和" },
        { "ds_1221c_hd", "偶尔打盹" },
        { "ds_1222b_hd", "午餐的谢礼" },
        { "ds_1223c_hd", "去年的传闻" },
        { "ds_1224c_hd", "试试看" },
        { "ds_1225a_hd", "派对清晨" },
        { "ds_1225b_hd", "选美比赛＠圣诞派对" },
        { "ds_1226a_hd", "昨日很抱歉" },
        { "ds_1227a_hd", "今日依旧忙碌" },
        { "ds_1228a_hd", "到达本岛的邮件" },
        { "ds_1228b_hd", "车中的她" },
        { "ds_1228d_hd", "突然的夜晚约会" },
        { "ds_1229a_hd", "来自主岛的邮件" },
        { "ds_1304d_hd", "一起拍照" },
        { "ds_1305d_hd", "卡拉OK与约会" },
        { "ds_1306d_hd", "夜海与吻" },
        { "ds_1307d_hd", "肌肤相亲" },
        { "ds_1308a_hd", "开学典礼的早上" },
        { "ds_1308b_hd", "那是梦。那是梦？" },
        { "ds_1308d_hd", "梦幻般的约会" },
        { "ds_1309b_hd", "昼日时的会长" },
        { "ds_1309d_hd", "来者何人？" },
        { "ds_1310a_hd", "听到那个名字……" },
        { "ds_1311b_hd", "自行调查" },
        { "ds_1311c_hd", "关于春阳的情报" },
        { "ds_1312c_hd", "不要见春阳……" },
        { "ds_1313c_hd", "坚持的会长" },
        { "ds_1314b_hd", "咖喱战" },
        { "ds_1315c_hd", "至少要传达过去" },
        { "ds_1317d_hd", "那不可能" },
        { "ds_1318b_hd", "会长的午休" },
        { "ds_1319b_hd", "大和口中所谓的邑崎遥月" },
        { "ds_1322b_hd", "终于倒下" },
        { "ds_1322c_hd", "从保健室到家里" },
        { "ds_1323d_hd", "帮帮那个孩子" },
        { "ds_1324a_hd", "决战之日的早晨" },
        { "ds_1324b_hd", "父亲的想法" },
        { "ds_1324c1_hd", "十年间的真相" },
        { "ds_1324c2_hd", "亲子再会" },
        { "ds_1324c3_hd", "试用期结束" },
        { "ds_1324d_hd", "身心相连" },
        { "ds_1412c_hd", "邑崎会长的讲演" },
        { "ds_1218c_io", "魔王之女站了出来" },
        { "ds_1219b_io", "选美出场作战" },
        { "ds_1219c_io", "魔王军的财政事务" },
        { "ds_1220b_io", "依爱的工房" },
        { "ds_1221b_io", "最强同盟" },
        { "ds_1222b_io", "梦见之物" },
        { "ds_1223c_io", "张开黑翼" },
        { "ds_1224c_io", "停战协议" },
        { "ds_1225a_io", "决战之晨" },
        { "ds_1225b_io", "魔王之女立于舞台" },
        { "ds_1226b_io", "救出使魔作战" },
        { "ds_1227b_io", "牵手而归" },
        { "ds_1228a_io", "依爱连内衣也是黑色" },
        { "ds_1228b_io", "魔女的姐姐" },
        { "ds_1229d_io", "虽然顺序不同" },
        { "ds_1230a_io", "汝所显之物为" },
        { "ds_1231d_io", "今年的缄毫无防备" },
        { "ds_1301b_io", "初次参拜路途遥远" },
        { "ds_1302b_io", "不像样的声调" },
        { "ds_1304b_io", "随从所能做的事" },
        { "ds_1305b_io", "本来是海水浴但是" },
        { "ds_1306b_io", "像是依爱会做的事" },
        { "ds_1307b_io", "从未改变之物" },
        { "ds_1308a_io", "迎接新学期" },
        { "ds_1308c_io", "与朋友相谈" },
        { "ds_1309d_io", "同志" },
        { "ds_1310a_io", "阳茉莉的违和感" },
        { "ds_1310b_io", "最害怕的事" },
        { "ds_1310c_io", "封闭的意识" },
        { "ds_1311c_io", "与梦之世界诉说" },
        { "ds_1312c_io", "带上喜欢的礼物" },
        { "ds_1313c_io", "支撑" },
        { "ds_1314d_io", "无法咬合的齿轮" },
        { "ds_1315a_io", "即便只有心意" },
        { "ds_1315c_io", "无声的房间" },
        { "ds_1316c_io", "为了幸福" },
        { "ds_1316c2_io", "决意" },
        { "ds_1316d_io", "勇者立于魔界" },
        { "ds_1317c_io", "依爱和YiAi" },
        { "ds_1317c2_io", "紧握的双手" },
        { "ds_1317d_io", "新的契约" },
        { "ds_1318c_io", "果然是魔王之女" },
        { "ds_1318d_io", "幸福时光" },
        { "ds_2014a_io", "今后的二人" },
        { "ds_1218c_ne", "为了你而能做的" },
        { "ds_1219b_ne", "面向选美的角色塑造" },
        { "ds_1220b_ne", "回忆中的咖喱" },
        { "ds_1221c_ne", "It's show time！" },
        { "ds_1222c_ne", "妹妹的电话" },
        { "ds_1223c_ne", "倾向与对策" },
        { "ds_1224d_ne", "好戏在明日" },
        { "ds_1225b_ne", "告白" },
        { "ds_1226b_ne", "初次约会" },
        { "ds_1226d_ne", "明确关系" },
        { "ds_1227c_ne", "再次？还是第一次的约会" },
        { "ds_1228a_ne", "变化的二人" },
        { "ds_1228c_ne", "心灵相触" },
        { "ds_1229c_ne", "两人一起做的料理之味" },
        { "ds_1229d_ne", "第一次交合" },
        { "ds_1230a_ne", "两人共同迎接的初始之晨" },
        { "ds_1230b_ne", "有趣的海边约会" },
        { "ds_1231d_ne", "能组成一个家庭吗？" },
        { "ds_1301a_ne", "有点小误会" },
        { "ds_1302b_ne", "充满怀念的回忆" },
        { "ds_1303c_ne", "乃绘里的温柔挂念" },
        { "ds_1304c_ne", "绝不能越过的底线" },
        { "ds_1304d_ne", "浴池的秘事" },
        { "ds_1306b_ne", "一句也听不进去" },
        { "ds_1307c_ne", "开始变化的日常" },
        { "ds_1308a_ne", "被关注的两人" },
        { "ds_1308c_ne", "这就是乃绘里的掩羞" },
        { "ds_1311a_ne", "别把我当小孩" },
        { "ds_1311b_ne", "噩梦" },
        { "ds_1312a_ne", "幸福还是不幸" },
        { "ds_1313a_ne", "不幸福？" },
        { "ds_1314a_ne", "为难的管理者" },
        { "ds_1316a_ne", "真正的幸福" },
        { "ds_1317d_ne", "洋溢而出的幸福残片" },
        { "ds_1318b_ne", "寒意渐变为痛苦" },
        { "ds_1319b_ne", "等不了三分钟" },
        { "ds_1320b_ne", "即将真相大白" },
        { "ds_1320c_ne", "真正的一家人" },
        { "ds_1414b_ne", "为了绝对幸福的第一步" },
        { "ds_1218c_am", "初次弹额头！" },
        { "ds_1221c_am", "由你来出场！" },
        { "ds_1222c_am", "摇身一变！" },
        { "ds_1224c_am", "模拟讨论特训！" },
        { "ds_1225a_am", "派对之晨！" },
        { "ds_1225b_am", "选美比赛！" },
        { "ds_1226b_am", "难解的幸福！" },
        { "ds_1227c_am", "我会一同考虑的！" },
        { "ds_1228a_am", "恋爱确实能带来幸福！" },
        { "ds_1228b_am", "果然是这样的流程！" },
        { "ds_1229b_am", "进行了约会！？" },
        { "ds_1230b_am", "女生搭讪真的好吗！？" },
        { "ds_1231d_am", "问候非常重要！" },
        { "ds_1301b_am", "二礼二拍一礼！" },
        { "ds_1303c_am", "山中自然风光美不胜收！" },
        { "ds_1307d_am", "星空光耀艳丽。" },
        { "ds_1308b_am", "充分享受学园生活了吗！？" },
        { "ds_1310b_am", "嘿，跑哪儿去了？" },
        { "ds_1313c_am", "是巧克力香蕉！" },
        { "ds_1315a_am", "是本地新闻吗…" },
        { "ds_1316a_am", "非常担心…" },
        { "ds_1316d_am", "内心的波动…" },
        { "ds_1317b_am", "我内心的想法…" },
        { "ds_1318c_am", "认真传达过去。" },
        { "ds_1319c_am", "一起吃巧克力香蕉吧！" },
        { "ds_1320a_am", "早上好哟！" },
        { "ds_1321d_am", "我们之间的接触方法。" },
        { "ds_1322c_am", "到底要去哪儿――！？" },
        { "ds_1322d_am", "牵绊在一起的我们。" },
        { "ds_1323b_am", "海也是如此美丽！" },
        { "ds_1323d_am", "我想对你说…" },
        { "ds_1325a_am", "天近在咫尺的学园。" },
        { "ds_1325c_am", "一切皆可实现！" },
        { "ds_1325d_am", "果然还是受不了…" },
        { "ds_1607b_am", "心跳不已与天相拥。" }
};

void CopyBlockEng()
{
    memcpy((void*)(BaseAddr + 0x98878), SaveTitleEng, sizeof(SaveTitleEng));
}

void CopyBlockJpn()
{
    memcpy((void*)(BaseAddr + 0x96878), SaveTitleJpn, sizeof(SaveTitleJpn));
}
//*/
BOOL APIENTRY DllMain( HMODULE hModule,
                       DWORD  ul_reason_for_call,
                       LPVOID lpReserved
                     )
{
    switch (ul_reason_for_call)
    {
    case DLL_PROCESS_ATTACH:
		//make_console();
		//GetSelTitle();
        //CopyBlock();
        CopyBlockJpn();
		//APIHook();
    case DLL_THREAD_ATTACH:
    case DLL_THREAD_DETACH:
    case DLL_PROCESS_DETACH:
        break;
    }
    return TRUE;
}

__declspec(dllexport)void WINAPI AyamiKaze()
{
}